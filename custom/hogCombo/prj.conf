## prj.conf
```kconfig
###########################
#     FROM GATT.conf
###########################

# Incresed stack due to settings API usage
CONFIG_SYSTEM_WORKQUEUE_STACK_SIZE=3072
CONFIG_FLASH=y
CONFIG_FLASH_PAGE_LAYOUT=y
CONFIG_FLASH_MAP=y
CONFIG_NVS=y
CONFIG_SETTINGS=y

CONFIG_BT=y
CONFIG_BT_PERIPHERAL=y
CONFIG_BT_SMP=y
CONFIG_BT_DIS=y
CONFIG_BT_BAS=y
CONFIG_BT_DEVICE_NAME="HoG Combo Posix"
# CONFIG_BT_DEVICE_APPEARANCE=961
CONFIG_BT_SETTINGS=y
CONFIG_BT_DEBUG_LOG=y
# CONFIG_BT_BUF_CMD_TX_COUNT=10

###########################
#     FROM USB.conf
###########################

# CONFIG_USB=y
# CONFIG_USB_DEVICE_STACK=y
# CONFIG_USB_DEVICE_PRODUCT="HoG TTY Input"
# CONFIG_USB_CDC_ACM=y
# CONFIG_USB_DEVICE_LOG_LEVEL_ERR=y

# CONFIG_ETH_NATIVE_POSIX_STARTUP_AUTOMATIC=y

CONFIG_SERIAL=y
CONFIG_UART_NATIVE_POSIX=y
# CONFIG_UART_NATIVE_WAIT_PTS_READY_ENABLE=y
# CONFIG_CONSOLE=y
# CONFIG_UART_CONSOLE=y

# CONFIG_UART_LINE_CTRL=y
# CONFIG_UART_INTERRUPT_DRIVEN=y
# CONFIG_UART_0_INTERRUPT_DRIVEN=y

CONFIG_NATIVE_UART_0_ON_OWN_PTY=y
# CONFIG_NATIVE_UART_0_ON_STDINOUT=y
# CONFIG_UART_NATIVE_POSIX_PORT_1_ENABLE=y

###########################
#       CUSTOM
###########################
CONFIG_RING_BUFFER=y
CONFIG_HEAP_MEM_POOL_SIZE=256
CONFIG_BT_KEYS_OVERWRITE_OLDEST=y
CONFIG_BT_SMP_ALLOW_UNAUTH_OVERWRITE=y
# CONFIG_GPIO=y
# CONFIG_LED=y
# CONFIG_PWM=y
```

## src/main.c
```c
/* main.c - Application main entry point */

/*
 * Copyright (c) 2016 Intel Corporation
 *
 * SPDX-License-Identifier: Apache-2.0
 */

#include <sys/printk.h>
#include <sys/ring_buffer.h>
#include "gatt.h"
#include "uart.h"

#define RING_BUF_SIZE 1024

/* size of stack area used by each thread */
#define STACKSIZE 1024

/* scheduling priority used by each thread */
#define PRIORITY 7

char logBuffer[128];
uint8_t ring_buffer[RING_BUF_SIZE];
struct ring_buf ringbuf;

void printLog(char *msg)
{
	printk("%s\n", msg);
}

void main(void)
{
	ring_buf_init(&ringbuf, sizeof(ring_buffer), ring_buffer);
	printk("start HoG Combo\n");
	console("start HoG Combo");
	
	//gattStart();
}

K_THREAD_DEFINE(uartStartId, STACKSIZE, uartStart, NULL, NULL, NULL, PRIORITY, 0, 0);
K_THREAD_DEFINE(gattStartId, STACKSIZE, gattStart, NULL, NULL, NULL, PRIORITY, 0, 0);
```

## src/gatt.c
```c
/* main.c - Application main entry point */

/*
 * Copyright (c) 2016 Intel Corporation
 *
 * SPDX-License-Identifier: Apache-2.0
 */

#include <zephyr/types.h>
#include <stddef.h>
#include <stdio.h>
#include <string.h>
#include <errno.h>
#include <sys/printk.h>
#include <sys/byteorder.h>
#include <zephyr.h>

#include <settings/settings.h>

#include <bluetooth/bluetooth.h>
#include <bluetooth/hci.h>
#include <bluetooth/conn.h>
#include <bluetooth/uuid.h>
#include <bluetooth/gatt.h>

#include "hog.h"
#include "main.h"
#include "uart.h"

int isConnected = 0;
int isAdvertising = 0;

static const struct bt_data ad[] = {
	BT_DATA_BYTES(BT_DATA_GAP_APPEARANCE, 0xc1, 0x03),
	BT_DATA_BYTES(BT_DATA_FLAGS, (BT_LE_AD_GENERAL | BT_GAP_NO_TIMEOUT | BT_LE_AD_NO_BREDR)),
	BT_DATA_BYTES(BT_DATA_UUID16_ALL, BT_UUID_16_ENCODE(BT_UUID_HIDS_VAL), BT_UUID_16_ENCODE(BT_UUID_BAS_VAL)),
};

void startAdvertising()
{
	int err=0;
	
	if(isAdvertising != 0) {
		console("Abort startAdvertising: Already advertising");
		return;
	}
	
	err = bt_le_adv_start(BT_LE_ADV_CONN_NAME, ad, ARRAY_SIZE(ad), NULL, 0);
	
	if(err) {
		sprintf(logBuffer, "Abort startAdvertising, err: %d", err);
		console(logBuffer);
		return;
	}
	
	printk("Advertising started\n");
	console("Advertising started");
	isAdvertising = 1;
}

static void bt_ready(int err)
{
	if (err) {
		console("Bluetooth init failed");
		return;
	}

	if(IS_ENABLED(CONFIG_SETTINGS)) settings_load();

	printk("Bluetooth started\n");
	console("Bluetooth started");
	
	isConnected = 0;
	isAdvertising = 0;
	startAdvertising();
}

static void connected(struct bt_conn *conn, uint8_t status)
{
	sprintf(logBuffer, "Connected status: %d", status);
	console(logBuffer);

	if(status) {
		console("Failed to connect");
		return;
	}

	isConnected = 1;
	isAdvertising = 0;
}

static void disconnected(struct bt_conn *conn, uint8_t reason)
{
	char addr[BT_ADDR_LE_STR_LEN];

	bt_addr_le_to_str(bt_conn_get_dst(conn), addr, sizeof(addr));

	sprintf(logBuffer, "Disconnected reason: %d", reason);
	console(logBuffer);
	
	isConnected = 0;
	isAdvertising = 0;
}

static void security_changed(struct bt_conn *conn, bt_security_t level, enum bt_security_err err)
{
	char addr[BT_ADDR_LE_STR_LEN];

	bt_addr_le_to_str(bt_conn_get_dst(conn), addr, sizeof(addr));

	if (!err) {
		sprintf(logBuffer, "Security changed: L%d", level);
		console(logBuffer);
	} else {
		sprintf(logBuffer, "Security change failed, level: %d, err: %d", level, err);
		console(logBuffer);
	}
}

static struct bt_conn_cb conn_callbacks = {
	.connected = connected,
	.disconnected = disconnected,
	.security_changed = security_changed,
};

static void auth_pairing_confirm(struct bt_conn *conn)
{
	int reply;
	
	reply = bt_conn_auth_pairing_confirm(conn);
	
	sprintf(logBuffer, "Confirm Pairing, result: %d", reply);
	console(logBuffer);
}

static void auth_cancel(struct bt_conn *conn)
{
	char addr[BT_ADDR_LE_STR_LEN];

	bt_addr_le_to_str(bt_conn_get_dst(conn), addr, sizeof(addr));

	console("Pairing cancel");
}

static struct bt_conn_auth_cb auth_cb_display = {
	.pairing_confirm = auth_pairing_confirm,
	.cancel = auth_cancel,
};

void gattStart()
{
	printk("gattStart\n");
	console("gattStart");
	int err;

	err = bt_enable(bt_ready);
	
	if (err) {
		console("Bluetooth init failed");
		return;
	}
	
	//settings_load();
	bt_conn_cb_register(&conn_callbacks);
	bt_conn_auth_cb_register(&auth_cb_display);
}
```

## src/gatt.h
```c
/** @file
 *  @brief HoG Service sample
 */

/*
 * Copyright (c) 2016 Intel Corporation
 *
 * SPDX-License-Identifier: Apache-2.0
 */

#ifdef __cplusplus
extern "C" {
#endif

void gattStart();
void startAdvertising();
extern int isConnected;

#ifdef __cplusplus
}
#endif
```

## src/uart.c
```c
#include <stdio.h>
#include <drivers/uart.h>
#include <sys/ring_buffer.h>
#include <sys/printk.h>

#include "main.h"
#include "hog.h"

const struct device *ioPort;

const struct uart_config uartConfig = {
	.baudrate = 115200,
	.parity = UART_CFG_PARITY_NONE,
	.stop_bits = UART_CFG_STOP_BITS_1,
	.data_bits = UART_CFG_DATA_BITS_8,
	.flow_ctrl = UART_CFG_FLOW_CTRL_NONE
};

int charCount;
uint8_t charBuffer[64];
uint32_t dtr = 0U;
char consoleBuffer[128];

void console(char *message)
{
	//printk("%s\n", message);
	//return;
	
	ring_buf_put(&ringbuf, message, strlen(message));
	ring_buf_put(&ringbuf, "\r\n", 2);
}
	
void addChar(unsigned char inputChar)
{
	if(charCount == 0 && inputChar != 0xff) {
		sprintf(consoleBuffer, "Abort addChar: invalid charBuffer[0] 0xff value: x%02x", inputChar);
		console(consoleBuffer);
		return;
	}

	charBuffer[charCount] = inputChar;
	++charCount;
	if(charCount < 6) return;
	
	int logIndex=0;
	
	sendReport(charBuffer);
	
	for(int charIndex = 0 ; charIndex != 6 ; charIndex++) {
		if(charIndex) logIndex += sprintf(&consoleBuffer[logIndex], ",");		
		logIndex += sprintf(&consoleBuffer[logIndex], "x%02x", charBuffer[charIndex]);
	}
	
	ring_buf_put(&ringbuf, consoleBuffer, strlen(consoleBuffer));
	ring_buf_put(&ringbuf, "\r\n", 2);
	
	charCount=0;
	memset(charBuffer, 0, sizeof(charBuffer));
}

void uartStart()
{
	printk("uartStart\n");
	console("uartStart");
	unsigned char inChar = 0x00, outChar = 0x00;
	int ret;
	
	ioPort = device_get_binding("UART_0");
	
	if (!ioPort){
		sprintf(consoleBuffer, "UART_0 binding failed, ioPort: %p", ioPort);
		console(consoleBuffer);
		return;
	}
	
	ret = uart_configure(ioPort, &uartConfig);
	if (!ret){
		sprintf(consoleBuffer, "uart_configure failed, ret: %d", ret);
		console(consoleBuffer);
		return;
	}
	
	charCount=0;
	memset(charBuffer, 0, sizeof(charBuffer));
	console("** uartInput started, wait for input **");
	k_sleep(K_MSEC(1000));
	
	while (true) {
		k_cpu_idle();		
		
		while(uart_poll_in(ioPort, &inChar) == 0) {
			if(!(dtr==0 && inChar==0x0d)) addChar(inChar);
			dtr = 1;
		}
		
		if(dtr == 0) continue;
		
		while(ring_buf_get(&ringbuf, &outChar, 1) > 0) {
			uart_poll_out(ioPort, outChar);
		}
	}
}
```

## src/uart.h
```c
/** @file
 *  @brief HoG Service sample
 */

/*
 * Copyright (c) 2016 Intel Corporation
 *
 * SPDX-License-Identifier: Apache-2.0
 */

#ifdef __cplusplus
extern "C" {
#endif

void uartStart(void);
void console(char *);
extern char consoleBuffer[];

#ifdef __cplusplus
}
#endif
```
