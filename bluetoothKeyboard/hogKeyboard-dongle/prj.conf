## prj.conf
```kconfig
###########################
#     FROM GATT.conf
###########################

# Incresed stack due to settings API usage
CONFIG_SYSTEM_WORKQUEUE_STACK_SIZE=3072
CONFIG_FLASH=y
CONFIG_FLASH_PAGE_LAYOUT=y
CONFIG_FLASH_MAP=y
CONFIG_NVS=y
CONFIG_SETTINGS=y

CONFIG_BT=y
CONFIG_BT_PERIPHERAL=y
CONFIG_BT_SMP=y
CONFIG_BT_DIS=y
CONFIG_BT_BAS=y
CONFIG_BT_DEVICE_NAME="HoG Combo Keyboard"
CONFIG_BT_DEVICE_APPEARANCE=961
CONFIG_BT_SETTINGS=y
# CONFIG_BT_DEBUG_LOG=y

###########################
#     FROM USB.conf
###########################

CONFIG_USB_DEVICE_STACK=y
CONFIG_USB_DEVICE_PRODUCT="HoG TTY Input"
CONFIG_USB_CDC_ACM=y
# CONFIG_USB_DEVICE_LOG_LEVEL_ERR=y
# CONFIG_USB_DRIVER_LOG_LEVEL_ERR=y

CONFIG_SERIAL=y
CONFIG_UART_INTERRUPT_DRIVEN=y
CONFIG_UART_LINE_CTRL=y

###########################
#       CUSTOM
###########################
CONFIG_HEAP_MEM_POOL_SIZE=256
CONFIG_BT_KEYS_OVERWRITE_OLDEST=y
CONFIG_BT_SMP_ALLOW_UNAUTH_OVERWRITE=y
CONFIG_GPIO=y
CONFIG_LED=y
CONFIG_PWM=y
```

## src/main.c
```c
/* main.c - Application main entry point */

/*
 * Copyright (c) 2016 Intel Corporation
 *
 * SPDX-License-Identifier: Apache-2.0
 */

#include "gatt.h"
#include "usb.h"
#include "led.h"

void main(void)
{
	usbStart();
	
	log("start HoG Combo");
	gattStart();
}
```

## src/led.h
```c
/** @file
 *  @brief HoG Service sample
 */

/*
 * Copyright (c) 2016 Intel Corporation
 *
 * SPDX-License-Identifier: Apache-2.0
 */

#ifdef __cplusplus
extern "C" {
#endif

void setConnectState(int);
void setAdvertiseState(int);

#ifdef __cplusplus
}
#endif
```

## src/usb.h
```c
/** @file
 *  @brief HoG Service sample
 */

/*
 * Copyright (c) 2016 Intel Corporation
 *
 * SPDX-License-Identifier: Apache-2.0
 */

#ifdef __cplusplus
extern "C" {
#endif

void usbStart(void);
void log(char*);
extern char logBuffer[];

#ifdef __cplusplus
}
#endif
```
