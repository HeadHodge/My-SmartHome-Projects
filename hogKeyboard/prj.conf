## prj.conf
```kconfig
###########################
#     FROM GATT.conf
###########################

# Incresed stack due to settings API usage
CONFIG_SYSTEM_WORKQUEUE_STACK_SIZE=3072
CONFIG_FLASH=y
CONFIG_FLASH_PAGE_LAYOUT=y
CONFIG_FLASH_MAP=y
CONFIG_NVS=y
CONFIG_SETTINGS=y

CONFIG_BT=y
CONFIG_BT_PERIPHERAL=y
CONFIG_BT_SMP=y
CONFIG_BT_DIS=y
CONFIG_BT_BAS=y
CONFIG_BT_DEVICE_NAME="HoG Combo Input"
CONFIG_BT_DEVICE_APPEARANCE=961
CONFIG_BT_SETTINGS=y
# CONFIG_BT_DEBUG_LOG=y

###########################
#     FROM USB.conf
###########################

CONFIG_USB=y
CONFIG_USB_DEVICE_STACK=y
CONFIG_USB_DEVICE_PRODUCT="HoG TTY Input"
CONFIG_USB_CDC_ACM=y
# CONFIG_USB_DEVICE_LOG_LEVEL_ERR=y
# CONFIG_USB_DRIVER_LOG_LEVEL_ERR=y

CONFIG_SERIAL=y
CONFIG_UART_INTERRUPT_DRIVEN=y
CONFIG_UART_LINE_CTRL=y

###########################
#       CUSTOM
###########################
CONFIG_HEAP_MEM_POOL_SIZE=256
CONFIG_BT_KEYS_OVERWRITE_OLDEST=y
CONFIG_BT_SMP_ALLOW_UNAUTH_OVERWRITE=y
CONFIG_GPIO=y
CONFIG_LED=y
CONFIG_PWM=y
```

## src/gatt.c
```c
/* main.c - Application main entry point */

/*
 * Copyright (c) 2016 Intel Corporation
 *
 * SPDX-License-Identifier: Apache-2.0
 */

#include <zephyr/types.h>
#include <stddef.h>
#include <stdio.h>
#include <string.h>
#include <errno.h>
#include <sys/printk.h>
#include <sys/byteorder.h>
#include <zephyr.h>

#include <settings/settings.h>

#include <bluetooth/bluetooth.h>
#include <bluetooth/hci.h>
#include <bluetooth/conn.h>
#include <bluetooth/uuid.h>
#include <bluetooth/gatt.h>

#include "hog.h"
#include "usb.h"
#include "led.h"

int isConnected = 0;

static const struct bt_data ad[] = {
	BT_DATA_BYTES(BT_DATA_GAP_APPEARANCE, 0xc1, 0x03),
	BT_DATA_BYTES(BT_DATA_FLAGS, (BT_LE_AD_GENERAL | BT_LE_AD_NO_BREDR)),
	BT_DATA_BYTES(BT_DATA_UUID16_ALL, BT_UUID_16_ENCODE(BT_UUID_HIDS_VAL), BT_UUID_16_ENCODE(BT_UUID_BAS_VAL)),
};

static void bt_ready(int err)
{
	if (err) {
		printk("Bluetooth init failed (err %d)\n", err);
		return;
	}

	//printk("Bluetooth initialized\n");
	log("Bluetooth initialized");

	//hog_init();

	if(IS_ENABLED(CONFIG_SETTINGS)) settings_load();

	err = bt_le_adv_start(BT_LE_ADV_CONN_NAME, ad, ARRAY_SIZE(ad), NULL, 0);
	
	if (err) {
		//printk("Advertising failed to start (err %d)\n", err);
		log("Advertising failed to start");
		return;
	}

	setConnectState(3);
	setAdvertiseState(3);
	log("Advertising successfully started");
}

static void connected(struct bt_conn *conn, uint8_t err)
{
	char addr[BT_ADDR_LE_STR_LEN];

	bt_addr_le_to_str(bt_conn_get_dst(conn), addr, sizeof(addr));

	if (err) {
		log("Failed to connect");
		return;
	}

	setConnectState(1);
	setAdvertiseState(1);
	log("Connected!");
	isConnected = 1;
	
	if (bt_conn_set_security(conn, BT_SECURITY_L2)) {
		//printk("Failed to set security\n");
		log("Failed to set security on connection");
	}
}

static void disconnected(struct bt_conn *conn, uint8_t reason)
{
	char addr[BT_ADDR_LE_STR_LEN];

	bt_addr_le_to_str(bt_conn_get_dst(conn), addr, sizeof(addr));

	//printk("Disconnected from %s (reason 0x%02x)\n", addr, reason);
	setConnectState(3);
	setAdvertiseState(3);
	log("Disconnected");
	isConnected = 0;
}

static void security_changed(struct bt_conn *conn, bt_security_t level, enum bt_security_err err)
{
	char addr[BT_ADDR_LE_STR_LEN];

	bt_addr_le_to_str(bt_conn_get_dst(conn), addr, sizeof(addr));

	if (!err) {
		sprintf(logBuffer, "Security changed: L%d", level);
		log(logBuffer);
	} else {
		sprintf(logBuffer, "Security change failed, level: %d, err: %d", level, err);
		log(logBuffer);
	}
}

static struct bt_conn_cb conn_callbacks = {
	.connected = connected,
	.disconnected = disconnected,
	.security_changed = security_changed,
};

static void auth_pairing_confirm(struct bt_conn *conn)
{
	int reply;
	
	reply = bt_conn_auth_pairing_confirm(conn);
	
	sprintf(logBuffer, "Confirm Pairing, result: %d", reply);
	log(logBuffer);
}

static void auth_cancel(struct bt_conn *conn)
{
	char addr[BT_ADDR_LE_STR_LEN];

	bt_addr_le_to_str(bt_conn_get_dst(conn), addr, sizeof(addr));

	//printk("Pairing cancelled: %s\n", addr);
	log("Pairing cancel");
}

static struct bt_conn_auth_cb auth_cb_display = {
	.pairing_confirm = auth_pairing_confirm,
	.cancel = auth_cancel,
};

void gattStart(void)
{
	int err;

	err = bt_enable(bt_ready);
	if (err) {
		log("Bluetooth init failed");
		return;
	}
	
	bt_conn_cb_register(&conn_callbacks);
	bt_conn_auth_cb_register(&auth_cb_display);
}
```

## src/hog.c
```c
/** @file
 *  @brief HoG Service sample
 */

/*
 * Copyright (c) 2016 Intel Corporation
 *
 * SPDX-License-Identifier: Apache-2.0
 */

#include <zephyr/types.h>
#include <stddef.h>
#include <stdio.h>
#include <string.h>
#include <errno.h>
#include <sys/printk.h>
#include <sys/byteorder.h>
#include <zephyr.h>

#include <bluetooth/bluetooth.h>
#include <bluetooth/hci.h>
#include <bluetooth/conn.h>
#include <bluetooth/uuid.h>
#include <bluetooth/gatt.h>

#include "usb.h"
#include "gatt.h"

enum {
    HIDS_REMOTE_WAKE = BIT(0),
    HIDS_NORMALLY_CONNECTABLE = BIT(1),
};

struct hids_info {
    uint16_t version; /* version number of base USB HID Specification */
    uint8_t code; /* country HID Device hardware is localized for. */
    uint8_t flags;
} __packed;

struct hids_report_reference {
    uint8_t id; /* report id */
    uint8_t type; /* report type */
} __packed;

static struct hids_info info = {
    .version = 0x0000,
    .code = 0x00,
    .flags = HIDS_NORMALLY_CONNECTABLE,
};

static uint8_t ctrl_point;

static uint8_t report_map[] = {
	//Report Reference Id = 1 (128 key Keyboard)
	//Modifier Byte: bit 0 is L CTRL, bit 1 is L SHIFT, bit 2 is L ALT, bit 3 is L GUI, bit 4 is R CTRL, bit 5 is R SHIFT, bit 6 is R ALT, and bit 7 is R GUI
	0x05, 0x01, 	  // Usage Page (Generic Desktop Ctrls)
	0x09, 0x06, 	  // Usage (Keyboard)
	0xa1, 0x01, 	  // Collection (Application)
	0x85, 0x01, 	  //   Report ID (1)
	0x05, 0x07, 	  //   Usage Page (Kbrd/Keypad)
	0x19, 0xe0, 	  //   Usage Minimum (0xE0)
	0x29, 0xe7, 	  //   Usage Maximum (0xE7)
	0x15, 0x00, 	  //   Logical Minimum (0)
	0x25, 0x01, 	  //   Logical Maximum (1)
	0x75, 0x01, 	  //   Report Size (1)
	0x95, 0x08, 	  //   Report Count (8)
	0x81, 0x02, 	  //   Input (Data,Var,Abs,No Wrap,Linear,Preferred State,No Null Position)
	0x95, 0x01, 	  //   Report Count (1)
	0x75, 0x08, 	  //   Report Size (8)
	0x15, 0x00, 	  //   Logical Minimum (0)
	0x25, 0x65, 	  //   Logical Maximum (101)
	0x05, 0x07, 	  //   Usage Page (Kbrd/Keypad)
	0x19, 0x00, 	  //   Usage Minimum (0x00)
	0x29, 0x65, 	  //   Usage Maximum (0x65)
	0x81, 0x00, 	  //   Input (Data,Array,Abs,No Wrap,Linear,Preferred State,No Null Position)
	0xc0,			  // End Collection

	//Report Reference Id = 2 (Consumer Entertainment Control)
	0x05, 0x0C, 	  // Usage Page (Consumer)
	0x09, 0x01, 	  // Usage (Consumer Control)
	0xA1, 0x01, 	  // Collection (Application)
	0x85, 0x02, 	  //   Report ID (2)
	0x75, 0x10, 	  //   Report Size (16)
	0x95, 0x01, 	  //   Report Count (1)
	0x15, 0x01,		  //   Logical Minimum (1)
	0x26, 0xff, 0x07, //   Logical Maximum (2047)
	0x19, 0x01, 	  //   Usage Minimum (Consumer Control)
	0x2A, 0xff, 0x07, //   Usage Maximum (0x07FF)
	0x81, 0x00, 	  //   Input (Data,Array,Abs,No Wrap,Linear,Preferred State,No Null Position)
	0xC0, 	  	  	  // End Collection

	//Report Reference Id = 3 (Generic Mouse)
	0x05, 0x01,       // Usage Page (Generic Desktop Ctrls)
    0x09, 0x02,       // Usage (Mouse)
    0xA1, 0x01,       // Collection (Application)
	0x85, 0x03, 	  //   Report ID (3)
    0x09, 0x01,       //   Usage (Pointer)
    0xA1, 0x00,       //   Collection (Physical)
    0x05, 0x09,       //     Usage Page (Button)
    0x19, 0x01,       //     Usage Minimum (0x01)
    0x29, 0x03,       //     Usage Maximum (0x03)
    0x15, 0x00,       //     Logical Minimum (0)
    0x25, 0x01,       //     Logical Maximum (1)
    0x95, 0x03,       //     Report Count (3)
    0x75, 0x01,       //     Report Size (1)
    0x81, 0x02,       //     Input (Data,Var,Abs,No Wrap,Linear,...)
    0x95, 0x01,       //     Report Count (1)
    0x75, 0x05,       //     Report Size (5)
    0x81, 0x03,       //     Input (Const,Var,Abs,No Wrap,Linear,...)
    0x05, 0x01,       //     Usage Page (Generic Desktop Ctrls)
    0x09, 0x30,       //     Usage (X)
    0x09, 0x31,       //     Usage (Y)
    0x15, 0x81,       //     Logical Minimum (-127)
    0x25, 0x7F,       //     Logical Maximum (127)
    0x75, 0x08,       //     Report Size (8)
    0x95, 0x02,       //     Report Count (2)
    0x81, 0x06,       //     Input (Data,Var,Rel,No Wrap,Linear,...)
    0xC0,             //   End Collection
    0xC0,             // End Collection
};

enum {
    HIDS_INPUT = 0x01,
    HIDS_OUTPUT = 0x02,
    HIDS_FEATURE = 0x03,
};

static ssize_t read_info(struct bt_conn *conn,
              const struct bt_gatt_attr *attr, void *buf,
              uint16_t len, uint16_t offset)
{
    log("hog: read_info");
    return bt_gatt_attr_read(conn, attr, buf, len, offset, attr->user_data,
                 sizeof(struct hids_info));
}

static ssize_t read_report_map(struct bt_conn *conn,
                   const struct bt_gatt_attr *attr, void *buf,
                   uint16_t len, uint16_t offset)
{
    log("hog: read_report_map");
    return bt_gatt_attr_read(conn, attr, buf, len, offset, report_map,
                 sizeof(report_map));
}

static ssize_t read_report(struct bt_conn *conn,
                 const struct bt_gatt_attr *attr, void *buf,
                 uint16_t len, uint16_t offset)
{
    log("hog: read_report");
	
	static uint8_t report_data[] = {
		0x00,	  // Modifer Code
		0x00, 	  // Key Code
	};
	
    return bt_gatt_attr_read(conn, attr, buf, len, offset, report_data, sizeof(report_data));
}

static ssize_t read_keyboard_report_reference(struct bt_conn *conn,
               const struct bt_gatt_attr *attr, void *buf,
               uint16_t len, uint16_t offset)
{
	static struct hids_report_reference report_reference = {
		.id = 0x01,
		.type = HIDS_INPUT,
	};
    
	log("hog: read_keyboard_report_reference");
    return bt_gatt_attr_read(conn, attr, buf, len, offset, &report_reference, sizeof(report_reference));
}

static ssize_t read_consumer_report_reference(struct bt_conn *conn,
               const struct bt_gatt_attr *attr, void *buf,
               uint16_t len, uint16_t offset)
{
	static struct hids_report_reference report_reference = {
		.id = 0x02,
		.type = HIDS_INPUT,
	};
    
	log("hog: read_consumer_report_reference");
    return bt_gatt_attr_read(conn, attr, buf, len, offset, &report_reference, sizeof(report_reference));
}

static ssize_t read_mouse_report_reference(struct bt_conn *conn,
               const struct bt_gatt_attr *attr, void *buf,
               uint16_t len, uint16_t offset)
{
	static struct hids_report_reference report_reference = {
		.id = 0x03,
		.type = HIDS_INPUT,
	};
    
	log("hog: read_mouse_report_reference");
    return bt_gatt_attr_read(conn, attr, buf, len, offset, &report_reference, sizeof(report_reference));
}

static ssize_t read_protocol_mode(struct bt_conn *conn,
                 const struct bt_gatt_attr *attr, void *buf,
                 uint16_t len, uint16_t offset)
{
    log("hog: read_protocol_mode");
	
	static uint8_t report_data[] = {
		0x01,	  // input report mode
	};
	
    return bt_gatt_attr_read(conn, attr, buf, len, offset, report_data, sizeof(report_data));
}

static ssize_t write_protocol_mode(struct bt_conn *conn,
                const struct bt_gatt_attr *attr,
                const void *buf, uint16_t len, uint16_t offset,
                uint8_t flags)
{
    log("hog: write_protocol_mode");

    uint8_t *value = attr->user_data;
	
	char snum[10];
	
	sprintf(snum, "%d", value[0]);
	log(snum);

    return len;
}

static void input_ccc_changed(const struct bt_gatt_attr *attr, uint16_t value)
{
volatile bool notify_enable;

	//ARG_UNUSED(attr);
	notify_enable = (value == BT_GATT_CCC_NOTIFY);
    sprintf(logBuffer, "hog: input_ccc_changed: %s", notify_enable ? "enabled" : "disabled");
	log(logBuffer);
}

static ssize_t write_ctrl_point(struct bt_conn *conn,
                const struct bt_gatt_attr *attr,
                const void *buf, uint16_t len, uint16_t offset,
                uint8_t flags)
{
    uint8_t *value = attr->user_data;

    log("hog: write_ctrl_point");
    
    if (offset + len > sizeof(ctrl_point)) {
        return BT_GATT_ERR(BT_ATT_ERR_INVALID_OFFSET);
    }

    memcpy(value + offset, buf, len);

    return len;
}

/* HID Service Declaration */
BT_GATT_SERVICE_DEFINE(hog_svc,
    BT_GATT_PRIMARY_SERVICE(BT_UUID_HIDS),

    BT_GATT_CHARACTERISTIC(BT_UUID_HIDS_REPORT,
		BT_GATT_CHRC_READ | BT_GATT_CHRC_NOTIFY, BT_GATT_PERM_READ,
		read_report, NULL, NULL),
		
		BT_GATT_DESCRIPTOR(BT_UUID_HIDS_REPORT_REF,
			BT_GATT_PERM_READ,
			read_keyboard_report_reference, NULL, NULL),
		
		BT_GATT_CCC(input_ccc_changed,
            BT_GATT_PERM_READ | BT_GATT_PERM_WRITE),

    BT_GATT_CHARACTERISTIC(BT_UUID_HIDS_REPORT,
		BT_GATT_CHRC_READ | BT_GATT_CHRC_NOTIFY, BT_GATT_PERM_READ,
		read_report, NULL, NULL),
		
		BT_GATT_DESCRIPTOR(BT_UUID_HIDS_REPORT_REF,
			BT_GATT_PERM_READ,
			read_consumer_report_reference, NULL, NULL),
		
		BT_GATT_CCC(input_ccc_changed,
            BT_GATT_PERM_READ | BT_GATT_PERM_WRITE),

    BT_GATT_CHARACTERISTIC(BT_UUID_HIDS_REPORT,
		BT_GATT_CHRC_READ | BT_GATT_CHRC_NOTIFY, BT_GATT_PERM_READ,
		read_report, NULL, NULL),
		
		BT_GATT_DESCRIPTOR(BT_UUID_HIDS_REPORT_REF,
			BT_GATT_PERM_READ,
			read_mouse_report_reference, NULL, NULL),
		
		BT_GATT_CCC(input_ccc_changed,
            BT_GATT_PERM_READ | BT_GATT_PERM_WRITE),

    BT_GATT_CHARACTERISTIC(BT_UUID_HIDS_REPORT_MAP,
		BT_GATT_CHRC_READ, BT_GATT_PERM_READ,
		read_report_map, NULL, NULL),

    BT_GATT_CHARACTERISTIC(BT_UUID_HIDS_PROTOCOL_MODE,
		BT_GATT_CHRC_READ | BT_GATT_CHRC_WRITE_WITHOUT_RESP, BT_GATT_PERM_READ,
		read_protocol_mode, write_protocol_mode, NULL),

    BT_GATT_CHARACTERISTIC(BT_UUID_HIDS_INFO,
		BT_GATT_CHRC_READ, BT_GATT_PERM_READ,
		read_info, NULL, &info),

    BT_GATT_CHARACTERISTIC(BT_UUID_HIDS_CTRL_POINT,
		BT_GATT_CHRC_WRITE_WITHOUT_RESP, BT_GATT_PERM_WRITE,
        NULL, write_ctrl_point, &ctrl_point),
);

void sendReport(uint8_t *buffer)
{
	int8_t result;
	uint8_t keyboard_report_data[2];
	uint8_t consumer_report_data[2];
	uint8_t mouse_report_data[3];
	uint8_t reportId = buffer[1];
		
	if(isConnected == 0) {
		sprintf(logBuffer, "Abort: Peer not connected.");
		log(logBuffer);
		return;
	}
	
	switch(reportId) {

	case 1:
		//keyboard report data
		keyboard_report_data[0] = buffer[2]; // Modifer Code
		keyboard_report_data[1] = buffer[3]; // Key Code
		
		result = bt_gatt_notify(NULL, &hog_svc.attrs[2], keyboard_report_data, sizeof(keyboard_report_data));
		sprintf(logBuffer, "***Sent Keyboard Report1: x%02x, x%02x result: %d", keyboard_report_data[0], keyboard_report_data[1], result);
		log(logBuffer);
		
		break;
	case 2:
		//consumer report data
		consumer_report_data[0] = buffer[2]; // lowbyte Key Code
		consumer_report_data[1] = buffer[3]; // highbyte Key Code

		result = bt_gatt_notify(NULL, &hog_svc.attrs[5], consumer_report_data, sizeof(consumer_report_data));
		sprintf(logBuffer, "***Sent Consumer Report2: x%02x, x%02x result: %d", consumer_report_data[0], consumer_report_data[1], result);
		log(logBuffer);
		
		break;
	case 3:
		//mouse report data
		mouse_report_data[0] = buffer[2]; // Modifer Code
		mouse_report_data[1] = buffer[3]; // Key Code
		mouse_report_data[2] = buffer[4]; // Key Code

 		result = bt_gatt_notify(NULL, &hog_svc.attrs[9], mouse_report_data, sizeof(mouse_report_data));
		sprintf(logBuffer, "***Sent Mouse Report3: x%02x, x%02x, x%02x, result: %d", mouse_report_data[0], mouse_report_data[1], mouse_report_data[2], result);
		log(logBuffer);
		
		break;
	default :
		sprintf(logBuffer, "Invalid reportId: %d", reportId);
		log(logBuffer);
	}
}

void hog_init(void)
{
    log("hog: hog_init");
}
```

## src/hog.h
```c
/** @file
 *  @brief HoG Service sample
 */

/*
 * Copyright (c) 2016 Intel Corporation
 *
 * SPDX-License-Identifier: Apache-2.0
 */

#ifdef __cplusplus
extern "C" {
#endif

void hog_init(void);
void sendReport(uint8_t *);

#ifdef __cplusplus
}
#endif
```

## src/usb.c
```c
/*
 * Copyright (c) 2019 Intel Corporation
 *
 * SPDX-License-Identifier: Apache-2.0
 */

/**
 * @file
 * @brief Sample echo app for CDC ACM class
 *
 * Sample app for USB CDC ACM class driver. The received data is echoed back
 * to the serial port.
 */

#include <stdio.h>
#include <string.h>
#include <device.h>
#include <drivers/uart.h>
#include <zephyr.h>
#include <usb/usb_device.h>

#include "hog.h"

const struct device *comPort;
char logBuffer[128];

void log(char* msg)
{
	sprintf(logBuffer, "%s\r\n", msg);
	uart_fifo_fill(comPort, logBuffer, strlen(logBuffer));
}

static void interrupt_handler(const struct device *comPort, void *user_data)
{
	ARG_UNUSED(user_data);
	uart_irq_update(comPort);

	//if (uart_irq_tx_ready(comPort)) uart_irq_tx_disable(comPort);
	//if (!uart_irq_rx_ready(comPort)) return;

	int recv_len, prnt_pos=0;
	uint8_t buffer[64];

	memset(buffer, 0, sizeof(buffer));
	recv_len = uart_fifo_read(comPort, buffer, sizeof(buffer));
	
	prnt_pos += sprintf(&logBuffer[prnt_pos], "***Received command: ");
	
	for (int i = 0 ; i != 6 ; i++) {
		if (i) prnt_pos += sprintf(&logBuffer[prnt_pos], ", ");		
		prnt_pos += sprintf(&logBuffer[prnt_pos], "x%02x", buffer[i]);
	}
	
	log(logBuffer);
	
	if(recv_len != 6 || buffer[0] != 0xff) {
		sprintf(logBuffer, "Abort: invalid buffer data, len: %d, buffer: %s", recv_len, buffer);
		log(logBuffer);
		return;
	}
	
	sendReport(buffer);
}

void usbStart(void)
{
	uint32_t baudrate, dtr = 0U;
	int ret;

	comPort = device_get_binding("CDC_ACM_0");
	if (!comPort) return;
	if (usb_enable(NULL) != 0) return;

	uart_irq_callback_set(comPort, interrupt_handler);
	uart_irq_rx_enable(comPort);

	/* Wait 1 sec for the host to do all settings */
	k_busy_wait(1000000);

	log("Wait for DTR");

	while (true) {
		uart_line_ctrl_get(comPort, UART_LINE_CTRL_DTR, &dtr);

		if (dtr)
			break;
		else
			k_sleep(K_MSEC(100)); //Give CPU resources to low priority threads.
	}

	log("DTR is set");

	/* They are optional, we use them to test the interrupt endpoint */
	ret = uart_line_ctrl_set(comPort, UART_LINE_CTRL_DCD, 1);
	if (ret) log("Failed to set DCD");

	ret = uart_line_ctrl_set(comPort, UART_LINE_CTRL_DSR, 1);
	if (ret) log("Failed to set DSR");

	ret = uart_line_ctrl_get(comPort, UART_LINE_CTRL_BAUD_RATE, &baudrate);
	if (ret) {
		log("Failed to get baudrate");
	} else {
		log("Baudrate detected");
	}
	
	log("*** Terminal Open ***");
}
```
